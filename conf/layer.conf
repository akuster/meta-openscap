## conf/layer.conf
```bitbake
# We have a conf and classes directory, add to BBPATH
BBPATH .= ":${LAYERDIR}"

# We have recipes-* directories, add to BBFILES
BBFILES += "${LAYERDIR}/recipes-*/*/*.bb \
	${LAYERDIR}/recipes-*/*/*.bbappend"

BBFILE_COLLECTIONS += "openscap"
BBFILE_PATTERN_openscap = "^${LAYERDIR}/"
BBFILE_PRIORITY_openscap = "6"

LAYERDEPENDS_openscap = "core openembedded-layer"

IMAGE_INSTALL_append = " openembedded-release os-release openscap oe-scap scap-security-guide"

IMAGE_FEATURES += 'package-management'
```
